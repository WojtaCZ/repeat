## boards/arm/repeat/Kconfig.board
```kconfig
# nRF5340 DK NRF5340 board configuration

# Copyright (c) 2019-2020 Nordic Semiconductor ASA
# SPDX-License-Identifier: Apache-2.0

if SOC_NRF5340_CPUAPP_QKAA

config BOARD_REPEAT_CPUAPP
	bool "nRF5340 DK nRF5340 Application MCU"

config BOARD_REPEAT_CPUAPP_NS
	bool "nRF5340 DK nRF5340 Application MCU non-secure"

endif # SOC_NRF5340_CPUAPP_QKAA

config BOARD_REPEAT_CPUNET
	bool "nRF5340 DK NRF5340 Network MCU"
	depends on SOC_NRF5340_CPUNET_QKAA
```

## boards/arm/repeat/repeat_cpuapp_defconfig
```kconfig
# SPDX-License-Identifier: Apache-2.0

CONFIG_SOC_SERIES_NRF53X=y
CONFIG_SOC_NRF5340_CPUAPP_QKAA=y
CONFIG_BOARD_REPEAT_CPUAPP=y

# Enable MPU
CONFIG_ARM_MPU=y

# Enable hardware stack protection
CONFIG_HW_STACK_PROTECTION=y

# Enable TrustZone-M
CONFIG_ARM_TRUSTZONE_M=y

# enable GPIO
CONFIG_GPIO=y

# Enable uart driver
CONFIG_SERIAL=y

# enable console
CONFIG_CONSOLE=y
CONFIG_UART_CONSOLE=n

CONFIG_PINCTRL=y

CONFIG_CLOCK_CONTROL_NRF_K32SRC_RC=y
CONFIG_CLOCK_CONTROL_NRF_K32SRC_RC_CALIBRATION=y
CONFIG_CLOCK_CONTROL_NRF_K32SRC_500PPM=y

# Networking config
CONFIG_NETWORKING=y

# w5500 driver config
CONFIG_GPIO=y
CONFIG_SPI=y
CONFIG_NET_L2_ETHERNET=y
CONFIG_ETH_W5100=y

#CONFIG_USB_DEVICE_REMOTE_WAKEUP=n


#CONFIG_USB_DEVICE_VID=0x1234
#CONFIG_USB_DEVICE_PID=0x1234
#CONFIG_USB_DEVICE_PRODUCT="REPEAT"
#CONFIG_USB_DEVICE_MANUFACTURER="Vojtech Vosahlo"
#CONFIG_USB_CDC_ACM=y
#CONFIG_USB_DEVICE_STACK=y

CONFIG_LOG=y
CONFIG_RTT_CONSOLE=y
CONFIG_USE_SEGGER_RTT=y
CONFIG_LOG_BACKEND_RTT=y
```

## boards/arm/repeat/repeat_cpuapp_ns_defconfig
```kconfig
# SPDX-License-Identifier: Apache-2.0

CONFIG_SOC_SERIES_NRF53X=y
CONFIG_SOC_NRF5340_CPUAPP_QKAA=y
CONFIG_BOARD_REPEAT_CPUAPP_NS=y

# Enable MPU
CONFIG_ARM_MPU=y

# Enable hardware stack protection
CONFIG_HW_STACK_PROTECTION=y

# Enable TrustZone-M
CONFIG_ARM_TRUSTZONE_M=y

# This Board implies building Non-Secure firmware
CONFIG_TRUSTED_EXECUTION_NONSECURE=y

# enable GPIO
CONFIG_GPIO=y

# Enable uart driver
CONFIG_SERIAL=n

# enable console
CONFIG_CONSOLE=y
CONFIG_UART_CONSOLE=n

CONFIG_PINCTRL=y

CONFIG_CLOCK_CONTROL_NRF_K32SRC_RC=y
CONFIG_CLOCK_CONTROL_NRF_K32SRC_RC_CALIBRATION=y
CONFIG_CLOCK_CONTROL_NRF_K32SRC_500PPM=y

#CONFIG_USB_DEVICE_REMOTE_WAKEUP=n

#CONFIG_USB_CDC_ACM=y
#CONFIG_USB_DEVICE_STACK=y

CONFIG_LOG=y
CONFIG_RTT_CONSOLE=y
CONFIG_USE_SEGGER_RTT=y
CONFIG_LOG_BACKEND_RTT=y
```

## boards/arm/repeat/repeat_cpunet_defconfig
```kconfig
# SPDX-License-Identifier: Apache-2.0

CONFIG_SOC_SERIES_NRF53X=y
CONFIG_SOC_NRF5340_CPUNET_QKAA=y
CONFIG_BOARD_REPEAT_CPUNET=y

# Enable MPU
CONFIG_ARM_MPU=y

# Enable hardware stack protection
CONFIG_HW_STACK_PROTECTION=y

# enable GPIO
CONFIG_GPIO=y

# Enable uart driver
#CONFIG_SERIAL=y

# enable console
#CONFIG_CONSOLE=y
#CONFIG_UART_CONSOLE=n

CONFIG_BT=y

CONFIG_PINCTRL=y

CONFIG_CLOCK_CONTROL_NRF_K32SRC_RC=y
CONFIG_CLOCK_CONTROL_NRF_K32SRC_RC_CALIBRATION=y
CONFIG_CLOCK_CONTROL_NRF_K32SRC_500PPM=y

CONFIG_USB_DEVICE_REMOTE_WAKEUP=n

CONFIG_MPSL=y
CONFIG_MPSL_FEM=y
CONFIG_MPSL_FEM_NRF21540_GPIO=y
CONFIG_MPSL_FEM_NRF21540_RUNTIME_PA_GAIN_CONTROL=y
CONFIG_MPSL_FEM_LOG_LEVEL_DBG=y
CONFIG_MPSL_LOG_LEVEL_DBG=y
```
