/*
 * Copyright (c) 2020 Nordic Semiconductor ASA
 *
 * SPDX-License-Identifier: Apache-2.0
 */

/dts-v1/;
#include <nordic/nrf5340_cpuappns_qkaa.dtsi>
#include "repeat_cpuapp_common.dts"

/ {
	model = "Repeat Application";
	compatible = "vojtech-vosahlo,repeat-cpuapp";

	chosen {
		zephyr,sram = &sram0_ns;
		zephyr,flash = &flash0;
		zephyr,code-partition = &slot0_ns_partition;
	};

	nrf_radio_fem: nrf21540 {
		compatible = "nordic,nrf21540-fem";
		supply-voltage-mv = <3300>;
	};

};

&pwm0 {
	pinctrl-0 = <&pwm0_default>;
	pinctrl-names = "default";
};
/delete-node/ &{/pin-controller/pwm0_default/group1/};
